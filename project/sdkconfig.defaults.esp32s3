## project/sdkconfig.defaults.esp32s3
```kconfig
# ESP32-S3-EYE: MobileNetV2 (ESP-DL) + LCD UI
CONFIG_IDF_TARGET="esp32s3"
CONFIG_ESPTOOLPY_FLASHMODE_QIO=y
CONFIG_ESPTOOLPY_FLASHSIZE_8MB=y
CONFIG_PARTITION_TABLE_CUSTOM=y
CONFIG_PARTITION_TABLE_OFFSET=0x9000
CONFIG_COMPILER_OPTIMIZATION_PERF=y
CONFIG_SPIRAM=y
CONFIG_SPIRAM_MODE_OCT=y
CONFIG_SPIRAM_SPEED_80M=y
# NOTE: SPIRAM_XIP_FROM_PSRAM intentionally OFF — keeps the 3.6MB model
# memory-mapped in flash instead of copying it into PSRAM, so the whole
# ~8MB PSRAM is free for the inference arena + LVGL draw buffers.
CONFIG_ESP_DEFAULT_CPU_FREQ_MHZ_240=y
CONFIG_ESP32S3_INSTRUCTION_CACHE_32KB=y
CONFIG_ESP32S3_DATA_CACHE_64KB=y
CONFIG_ESP32S3_DATA_CACHE_LINE_64B=y
CONFIG_ESP_SYSTEM_ALLOW_RTC_FAST_MEM_AS_HEAP=n
CONFIG_FATFS_LFN_HEAP=y
CONFIG_BSP_SD_FORMAT_ON_MOUNT_FAIL=y
CONFIG_ESP_MAIN_TASK_STACK_SIZE=10240
```
